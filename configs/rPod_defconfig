## configs/rPod_defconfig
```kconfig
BR2_arm=y
BR2_cortex_a7=y
BR2_ARM_FPU_NEON_VFPV4=y
BR2_CCACHE=y
BR2_KERNEL_HEADERS_VERSION=y
BR2_DEFAULT_KERNEL_VERSION="4.1.5"
BR2_PACKAGE_HOST_LINUX_HEADERS_CUSTOM_4_1=y
BR2_TOOLCHAIN_BUILDROOT_INET_RPC=y
BR2_TOOLCHAIN_BUILDROOT_WCHAR=y
BR2_TOOLCHAIN_BUILDROOT_CXX=y
BR2_TARGET_GENERIC_HOSTNAME="rPodPi"
BR2_TARGET_GENERIC_ISSUE="Welcome to rPod"
BR2_TARGET_GENERIC_ROOT_PASSWD="MoreCowbell"
BR2_TARGET_GENERIC_GETTY_PORT="tty1"
BR2_SYSTEM_DHCP="eth0"
BR2_ROOTFS_OVERLAY="board/rPod/rootfs_overlay"
BR2_ROOTFS_POST_BUILD_SCRIPT="board/rPod/post-build.sh"
BR2_LINUX_KERNEL=y
BR2_LINUX_KERNEL_CUSTOM_GIT=y
BR2_LINUX_KERNEL_CUSTOM_REPO_URL="https://github.com/raspberrypi/linux.git"
BR2_LINUX_KERNEL_CUSTOM_REPO_VERSION="592503752b6951972f161f04280683c5af38d173"
BR2_LINUX_KERNEL_DEFCONFIG="bcm2709"
BR2_LINUX_KERNEL_ZIMAGE=y
BR2_LINUX_KERNEL_DTS_SUPPORT=y
BR2_LINUX_KERNEL_INTREE_DTS_NAME="bcm2709-rpi-2-b"
BR2_PACKAGE_BSC_SLAVE=y
BR2_PACKAGE_PYTHONSCRIPTS=y
BR2_PACKAGE_RPI_GPIO=y
BR2_PACKAGE_TEENSY_LOADER_CLI=y
BR2_PACKAGE_CIFS_UTILS=y
BR2_PACKAGE_EXFAT=y
BR2_PACKAGE_EXFAT_UTILS=y
BR2_PACKAGE_NFS_UTILS=y
BR2_PACKAGE_RPI_FIRMWARE=y
# BR2_PACKAGE_RPI_FIRMWARE_INSTALL_DTB_OVERLAYS is not set
BR2_PACKAGE_PERL=y
BR2_PACKAGE_POSTGRESQL=y
BR2_PACKAGE_LIBUSB=y
BR2_PACKAGE_LIBUSB_COMPAT=y
BR2_PACKAGE_ZEROMQ=y
BR2_PACKAGE_DROPBEAR=y
BR2_PACKAGE_SAMBA4=y
BR2_PACKAGE_CPULOAD=y
BR2_PACKAGE_SUPERVISOR=y
BR2_PACKAGE_NANO=y
BR2_PACKAGE_UEMACS=y
BR2_TARGET_ROOTFS_INITRAMFS=y
# BR2_TARGET_ROOTFS_TAR is not set
```

## package/rPod/bsc-slave-tools/Config.in
```kconfig
config BR2_PACKAGE_BSC_SLAVE_TOOLS
        bool "rPod Telemetry"
        help
          The telemetry code for rPod.
```

## package/rPod/bsc-slave/Config.in
```kconfig
config BR2_PACKAGE_BSC_SLAVE
        bool "i2c slave"
	depends on BR2_LINUX_KERNEL
        help
          Hardware I2C slave support for the pi.
```

## package/rPod/datalogging/Config.in
```kconfig
config BR2_PACKAGE_DATALOGGING
        bool "rPod Datalogging"
        help
          The datalogging code for rPod
```

## package/rPod/pythonScripts/Config.in
```kconfig
config BR2_PACKAGE_PYTHONSCRIPTS
        bool "python scripts"
        help
          All the scripts we've written for the rPod
```

## package/rPod/rpi-gpio/Config.in
```kconfig
config BR2_PACKAGE_RPI_GPIO
        bool "python GPIO library"
        help
          The python library for accessing the Pi's gpio
```

## package/rPod/teensy-loader-cli/Config.in
```kconfig
config BR2_PACKAGE_TEENSY_LOADER_CLI
        bool "Teensy CLI Loader"
        help
          Downloads code to the Teensy uC.
```
